## conf/layer.conf
```bitbake
# We have a conf and classes directory, add to BBPATH
BBPATH .= ":${LAYERDIR}"

# We have recipes-* directories, add to BBFILES
BBFILES += "${LAYERDIR}/recipes-*/*/*.bb \
            ${LAYERDIR}/recipes-*/*/*.bbappend"

BBFILE_COLLECTIONS += "meta-rpi02w-custom"
BBFILE_PATTERN_meta-rpi02w-custom = "^${LAYERDIR}/"
BBFILE_PRIORITY_meta-rpi02w-custom = "99"

LAYERDEPENDS_meta-rpi02w-custom = "core"
LAYERSERIES_COMPAT_meta-rpi02w-custom = "scarthgap"
```
